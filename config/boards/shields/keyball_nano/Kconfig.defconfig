## config/boards/shields/keyball_nano/Kconfig.defconfig
```kconfig
if SHIELD_KEYBALL44_DONGLE

config ZMK_KEYBOARD_NAME
	default "Keyball44 Dongle"

config ZMK_SPLIT_BLE_ROLE_CENTRAL
	default y

config ZMK_SPLIT_BLE_CENTRAL_PERIPHERALS
	default 2

endif

if SHIELD_KEYBALL44_LEFT || SHIELD_KEYBALL44_RIGHT || SHIELD_KEYBALL44_DONGLE

config ZMK_SPLIT
	default y
	
endif

if ZMK_DISPLAY

config I2C
    default y

config SSD1306
    default y

choice ZMK_DISPLAY_WORK_QUEUE
    default ZMK_DISPLAY_WORK_QUEUE_DEDICATED
endchoice

endif

if LVGL

config LV_Z_VDB_SIZE
    default 64

config LV_DPI_DEF
    default 148

config LV_Z_BITS_PER_PIXEL
    default 1

choice LV_COLOR_DEPTH
    default LV_COLOR_DEPTH_1
endchoice

endif 
```
