## config/boards/shields/keyball_nano/Kconfig.shield
```kconfig
config SHIELD_KEYBALL44_LEFT
    def_bool $(shields_list_contains,keyball44_left)

config SHIELD_KEYBALL44_RIGHT
    def_bool $(shields_list_contains,keyball44_right)
```

## config/west.yml
```yaml
manifest:
  remotes:
    - name: zmkfirmware
      url-base: https://github.com/zmkfirmware
    - name: kumamuk-git
      url-base: https://github.com/kumamuk-git
    - name: nuovotaka
      url-base: https://github.com/nuovotaka
  projects:
    - name: zmk-pointing-acceleration-alpha
      remote: nuovotaka
      revision: main
    - name: zmk
      remote: zmkfirmware
      revision: v0.2
      import: app/west.yml
    - name: zmk-pmw3610-driver
      remote: kumamuk-git
      revision: main
  self:
    path: config
```
